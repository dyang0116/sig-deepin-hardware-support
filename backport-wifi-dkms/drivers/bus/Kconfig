## backport-wifi-dkms/drivers/bus/Kconfig
```kconfig
# SPDX-License-Identifier: GPL-2.0
#
# Bus Devices
#

menu "Bus devices"

source "drivers/bus/mhi/Kconfig"

endmenu
```

## backport-wifi-dkms/drivers/soc/Kconfig
```kconfig
# SPDX-License-Identifier: GPL-2.0-only
menu "SOC (System On Chip) specific Drivers"

source "drivers/soc/qcom/Kconfig"

endmenu
```
